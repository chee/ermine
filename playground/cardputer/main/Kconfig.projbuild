## playground/cardputer/main/Kconfig.projbuild
```kconfig
# the network (wifi.c) and the tippet server the den's room is on (poll.c): set with ./idf.sh
# menuconfig, "Cardputer: the den's network". Kept in sdkconfig, which git ignores: never in
# sdkconfig.defaults. Empty network: no WiFi, the den alone (and the shell)
menu "Cardputer: the den's network"

config CARDPUTER_WIFI_SSID
	string "WiFi network (SSID)"
	default ""
	help
		The network to join. Empty: no WiFi (the den alone, and the shell).

config CARDPUTER_WIFI_PASSWORD
	string "WiFi password"
	default ""
	help
		Empty: an open network.

config CARDPUTER_SERVER
	string "tippet server (https://host or http://host:port)"
	default "https://galaxy.observer"
	help
		Where the room is: its long-poll at <server>/littlesync/tippet/dens-<code>/send and /recv
		(experiments/tippet/WIRE.md). https: the certificate checked against ESP-IDF's bundle.

choice CARDPUTER_CARRIER
	prompt "Cardputer: how the den reaches galaxy"
	default CARDPUTER_CARRIER_WEBSOCKET
	help
		The tippet carrier to the server: a websocket (main/ws.c: one TLS session, the path the
		browsers use), or http long-poll (main/poll.c: send and recv requests).

config CARDPUTER_CARRIER_WEBSOCKET
	bool "websocket"

config CARDPUTER_CARRIER_POLL
	bool "http long-poll"

endchoice

config CARDPUTER_ROOM
	string "the den's room (4 of ACDEFHJKMNPRTWXY; empty: the one it has)"
	default ""
	help
		A room's code: the den goes to it and remembers it (NVS). Empty: the room it was in, or a
		new one made the first time.

config CARDPUTER_FORGETS
	bool "forget runs that have passed on to galaxy (tippet's try-out)"
	default n
	help
		The history keeps the newest state per node, and each snapshot lets go of the runs galaxy
		(a keeper) has: less heap and flash, and a late step older than the newest is passed over.

config CARDPUTER_GATEWAY
	string "littlesync gateway (the old path, out of the build: main/net.c)"
	default ""
	help
		The littlesync gateway net.c posted to, before tippet. Unused.

endmenu
```
